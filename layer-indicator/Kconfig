## layer-indicator/Kconfig
```kconfig
config ZMK_LAYER_INDICATOR_KEYS
    bool "Send F16-F19 to the computer when the active layer changes"
    default y
    depends on !ZMK_SPLIT || ZMK_SPLIT_ROLE_CENTRAL
    # NKRO 보고 방식은 기본적으로 F13~F24를 보내지 못하므로 확장 보고를 켠다
    select ZMK_HID_KEYBOARD_NKRO_EXTENDED_REPORT if ZMK_HID_REPORT_TYPE_NKRO
    help
      Layer 0 sends F16, layer 1 F17, layer 2 F18, layer 3 F19.
      A menu bar app on the computer reads these to show the current layer.
```
